## components/app_button/Kconfig.projbuild
```kconfig
menu "App Button"

    config APP_BUTTON_ENABLED
        bool "Enable app_button service"
        default y
        help
            Generic GPIO button handler with software debounce and
            press / release / long-press event modes.

    config APP_BUTTON_BOOT_GPIO
        int "BOOT button GPIO"
        depends on APP_BUTTON_ENABLED
        default 9
        range 0 30
        help
            ESP32-C6 BOOT button is wired to GPIO9. Override if your board
            uses a different pin.

    config APP_BUTTON_DEBOUNCE_MS
        int "Debounce window (ms)"
        depends on APP_BUTTON_ENABLED
        default 20
        range 5 100

endmenu
```

## components/app_http/Kconfig.projbuild
```kconfig
menu "App HTTP"

    config APP_HTTP_ENABLED
        bool "Enable app_http client"
        default y
        help
            Thin wrapper around esp_http_client. Each request runs on its own
            short-lived task so callbacks don't block the caller.

    config APP_HTTP_MAX_RESP_BYTES
        int "Maximum response body size (bytes)"
        depends on APP_HTTP_ENABLED
        default 4096
        range 256 65536
        help
            Responses larger than this are truncated. The buffer is malloc'd
            for the duration of the request.

    config APP_HTTP_TASK_STACK
        int "Per-request task stack size (bytes)"
        depends on APP_HTTP_ENABLED
        default 6144
        range 4096 16384

endmenu
```

## components/app_mqtt/Kconfig.projbuild
```kconfig
menu "App MQTT service"

    config APP_MQTT_ENABLED
        bool "Enable app_mqtt service"
        default y
        help
            Compile the optional MQTT client service. App code calls
            app_mqtt_init() with the broker URI, then app_mqtt_subscribe() /
            app_mqtt_publish(). When disabled, the calls compile out and the
            mqtt library is not linked.

    config APP_MQTT_MAX_SUBSCRIPTIONS
        int "Max simultaneous subscriptions"
        default 8
        range 1 32
        depends on APP_MQTT_ENABLED
        help
            Upper bound on app_mqtt_subscribe() calls. Storage is static —
            choose generously, each slot is small.

endmenu
```

## components/app_timer/Kconfig.projbuild
```kconfig
menu "App Timer"

    config APP_TIMER_ENABLED
        bool "Enable app_timer service"
        default y
        help
            Wraps esp_timer with a FreeRTOS work-queue so callbacks run in
            task context, never timer ISR context.

    config APP_TIMER_WORKER_STACK
        int "Worker task stack size (bytes)"
        depends on APP_TIMER_ENABLED
        default 4096
        range 2048 16384

    config APP_TIMER_QUEUE_LEN
        int "Pending callback queue length"
        depends on APP_TIMER_ENABLED
        default 16
        range 4 64

endmenu
```

## components/board_hal/Kconfig.projbuild
```kconfig
menu "Display"

    config BOARD_BACKLIGHT_PERCENT
        int "Default LCD backlight brightness (%)"
        range 0 100
        default 10
        help
            Backlight brightness applied at boot, as a percentage (0 = off,
            100 = full). Change at runtime by calling
            display_hal_set_brightness().

endmenu
```
